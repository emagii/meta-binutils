## conf/layer.conf
```bitbake
# We have a conf and classes directory, add to BBPATH
BBPATH .= ":${LAYERDIR}"

# We have recipes-* directories, add to BBFILES
BBFILES += "${LAYERDIR}/recipes-*/*/*.bb \
            ${LAYERDIR}/recipes-*/*/*.bbappend"

BBFILE_COLLECTIONS += "meta-binutils"
BBFILE_PATTERN_meta-binutils = "^${LAYERDIR}/"
BBFILE_PRIORITY_meta-binutils = "6"

LAYERDEPENDS_meta-binutils = "core"
LAYERSERIES_COMPAT_meta-binutils = "kirkstone"
```
